## PetaLinux/FinalProject/project-spec/configs/configs/Kconfig
```kconfig
mainmenu "PetaLinux System Configuration"
config SUBSYSTEM_TYPE_LINUX
        bool
        default y
        select SYSTEM_ZYNQMP

config SYSTEM_ZYNQMP
        bool "ZYNQMP Configuration"
        help
          ZYNQMP Configuration for the project.
          All these config options will be in /home/stealthadmin/ECEN5713/Repo_FinalProject/final-project-DonavonFaceyCU/PetaLinux/FinalProject/project-spec/configs/config

config SUBSYSTEM_VARIANT_ZYNQMPEV
        bool
        default y
        help

config SUBSYSTEM_DISTRO_PETALINUX
        bool
        default y
        help

source /home/stealthadmin/ECEN5713/Repo_FinalProject/final-project-DonavonFaceyCU/PetaLinux/FinalProject/project-spec/configs/configs/Kconfig.main
```

## PetaLinux/FinalProject/project-spec/meta-system-controller/conf/machine/eval-brd-sc-zynqmp.conf
```bitbake
#@TYPE: Machine
#@NAME: eval-brd-sc-zynqmp
#@DESCRIPTION: Machine configuration for vkp120, vckp180, vhk158, vek280 system controller.

#### Preamble
MACHINEOVERRIDES =. "${@['', 'eval-brd-sc-zynqmp:']['eval-brd-sc-zynqmp' !='${MACHINE}']}"
#### Regular settings follow

# Yocto device-tree variables
YAML_CONSOLE_DEVICE_CONFIG:pn-device-tree ?= "psu_uart_1"
YAML_MAIN_MEMORY_CONFIG:pn-device-tree ?= "psu_ddr_0"
DT_PADDING_SIZE:pn-device-tree ?= "0x1000"
DTC_FLAGS:pn-device-tree ?= ""
YAML_DT_BOARD_FLAGS ?= "{BOARD zynqmp-sc-revb}"

# Yocto u-boot-xlnx variables
UBOOT_MACHINE ?= "xilinx_zynqmp_virt_defconfig"

# Yocto PMUFW variables
YAML_COMPILER_FLAGS:append:pn-pmu-firmware = " "
YAML_SERIAL_CONSOLE_STDIN:pn-pmu-firmware ?= "psu_uart_1"
YAML_SERIAL_CONSOLE_STDOUT:pn-pmu-firmware ?= "psu_uart_1"

# Yocto FSBL variables
YAML_SERIAL_CONSOLE_STDIN:pn-fsbl-firmware ?= "psu_uart_1"
YAML_SERIAL_CONSOLE_STDOUT:pn-fsbl-firmware ?= "psu_uart_1"

# Serial Console Settings
SERIAL_CONSOLES ?= "115200;ttyPS0"
YAML_SERIAL_CONSOLE_BAUDRATE ?= "115200"

# Yocto arm-trusted-firmware(TF-A) variables
TFA_CONSOLE ?= "cadence"
TFA_BL33_LOAD ?= "0x8000000"

# Set DDR Base address for u-boot-xlnx-scr variables
DDR_BASEADDR ?= "0x0"
SKIP_APPEND_BASEADDR ?= "0"

# Yocto KERNEL Variables
UBOOT_ENTRYPOINT  ?= "0x200000"
UBOOT_LOADADDRESS ?= "0x200000"

# Yocto MACHINE_FEATURES Variable
MACHINE_FEATURES += "mali400 fpga-overlay"

# Yocto uboot device-tree variables
YAML_CONSOLE_DEVICE_CONFIG:pn-uboot-device-tree ?= "psu_uart_1"

# Required generic machine inclusion
require conf/machine/system-controller-generic.conf

# Add the following files to /boot
IMAGE_BOOT_FILES += "system-sc-revc-zynqmp.dtb system.dtb"
WKS_FILES = "system-controller-nobootpartition.wks"

# enable RAUC_DEMO for this board by default
SYSTEM_CONTROLLER_RAUC_DEMO = "yes"

# This is an 'XSCT' based BSP
XILINX_XSCT_VERSION = "2025.1"
XILINX_WITH_ESW = "xsct"

# Add system XSA
HDF_URI = "https://petalinux.xilinx.com/sswreleases/rel-v2025.1/hdf-examples/2025.1/2025.1_0517_1_05172018/external/eval-brd-sc/eval-brd-sc-2025.1_0517_1.xsa"
HDF_URI[sha256sum] = "a547cd03416049de0361a5ffd1717ef9a674f3efc82ffe4a11e5b87439bea6b7"

#### No additional settings should be after the Postamble
#### Postamble
PACKAGE_EXTRA_ARCHS:append = "${@['', ' eval_brd_sc_zynqmp']['eval-brd-sc-zynqmp' != '${MACHINE}']}"
```

## PetaLinux/uptimeclock/project-spec/configs/rootfsconfigs/Kconfig.user
```kconfig
menu "user packages " 
config libgpiod  
	 bool "libgpiod"
	 help
	
config libgpiod-tools  
	 bool "libgpiod-tools"
	 help
	
config gpio-demo  
	 bool "gpio-demo"
	 help
	
config peekpoke  
	 bool "peekpoke"
	 help
	
config uptimeclock  
	 bool "uptimeclock"
	 help
	
endmenu
```
